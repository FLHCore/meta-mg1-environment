## conf/layer.conf
```bitbake
# We have a conf and classes directory, add to BBPATH
BBPATH .= ":${LAYERDIR}"

# We have recipes-* directories, add to BBFILES
BBFILES += "${LAYERDIR}/recipes-*/*/*.bb \
            ${LAYERDIR}/recipes-*/*/*.bbappend"

BBFILE_COLLECTIONS += "mg1-environment"
BBFILE_PATTERN_mg1-environment = "^${LAYERDIR}/"
BBFILE_PRIORITY_mg1-environment = "6"

# 移除對特定發行版的依賴，讓它更靈活
LAYERDEPENDS_mg1-environment = "core meta-webserver"
LAYERSERIES_COMPAT_mg1-environment = "kirkstone" 
```
